## config/boards/arm/ergokeys_mcu_nrf52/Kconfig
```kconfig
# SPDX-License-Identifier: MIT

config BOARD_ENABLE_DCDC
    bool "Enable DCDC mode"
    select SOC_DCDC_NRF52X
    default y
    depends on (BOARD_ERGOKEYS_MCU_NRF52)

config BOARD_ENABLE_SOFTDEVICE
    bool "Enable Softdevice S140"
    default n
    depends on (BOARD_ERGOKEYS_MCU_NRF52)
```

## config/boards/arm/ergokeys_mcu_nrf52/Kconfig.board
```kconfig
# SPDX-License-Identifier: MIT

config BOARD_ERGOKEYS_MCU_NRF52
    bool "ergokeys_mcu_nrf52"
    depends on SOC_NRF52840_QIAA
```

## config/boards/arm/ergokeys_mcu_nrf52/Kconfig.defconfig
```kconfig
# Copyright (c) 2021 The ZMK Contributors
# SPDX-License-Identifier: MIT

if BOARD_ERGOKEYS_MCU_NRF52

config BOARD
	default "ergokeys_mcu_nrf52"

if USB_DEVICE_STACK

config USB_NRFX
    default y

endif # USB_DEVICE_STACK

config BT_CTLR
	default BT

config ZMK_BATTERY_VOLTAGE_DIVIDER
	default y

endif # BOARD_ERGOKEYS_MCU_NRF52
```

## config/boards/shields/ergokeys_alice75/Kconfig.shield
```kconfig
config SHIELD_ERGOKEYS_ALICE75
    def_bool $(shields_list_contains,ergokeys_alice75)
```
